bt0: bt0 {
  compatible = "zmk,behavior-macro";
  #binding-cells = <0>;
  tap-ms = <50>;
  wait-ms = <50>;
  bindings
  /* switch mouse */
  = <&macro_press>
  , <&kp F13>
  , <&macro_release>
  , <&kp F13>
  , <&macro_wait_time 50>
  /* switch keyboard */
  , <&macro_press>
  , <&bt BT_SEL 0>
  , <&macro_release>
  , <&bt BT_SEL 0>;
};
bt1: bt1 {
  compatible = "zmk,behavior-macro";
  #binding-cells = <0>;
  tap-ms = <50>;
  wait-ms = <50>;
  bindings
  /* switch mouse */
  = <&macro_press>
  , <&kp F14>
  , <&macro_release>
  , <&kp F14>
  , <&macro_wait_time 50>
  /* switch keyboard */
  , <&macro_press>
  , <&bt BT_SEL 1>
  , <&macro_release>
  , <&bt BT_SEL 1>;
};
