## config/west.yml
```yaml
manifest:
  remotes:
    - name: zmkfirmware
      url-base: https://github.com/zmkfirmware
    - name: refil
      url-base: https://github.com/refil
    - name: urob
      url-base: https://github.com/urob
  projects:
    - name: zmk
      remote: refil
      revision: adv360-z3.5-2
      import: app/west.yml

    # ZMK modules
    - name: zmk-adaptive-key
      remote: urob
      revision: v0.2
      path: modules/zmk/adaptive-key
    - name: zmk-auto-layer
      remote: urob
      revision: v0.2
      path: modules/zmk/auto-layer
    - name: zmk-helpers
      remote: urob
      revision: v0.2
      path: modules/zmk/helpers
    - name: zmk-leader-key
      remote: urob
      revision: v0.2
      path: modules/zmk/leader-key
    - name: zmk-tri-state
      remote: urob
      revision: v0.2
      path: modules/zmk/tri-state
  self:
    path: config
```
